## main/Kconfig.projbuild
```kconfig
menu "SoftAP MQTT Configuration"

    config ESP_WIFI_SOFTAP_SSID
        string "SoftAP SSID"
        default "ESP32-SoftAP"
        help
            SSID for the SoftAP network

    config ESP_WIFI_SOFTAP_PASSWORD
        string "SoftAP Password"
        default "12345678"
        help
            Password for the SoftAP network (minimum 8 characters)

    config ESP_WIFI_SOFTAP_CHANNEL
        int "SoftAP Channel"
        range 1 14
        default 1
        help
            WiFi channel for SoftAP

    config ESP_MQTT_BROKER_URI
        string "MQTT Broker URI"
        default "mqtt://test.mosquitto.org"
        help
            MQTT broker URI

    config ESP_MQTT_PORT
        int "MQTT Port"
        range 1 65535
        default 1883
        help
            MQTT broker port

endmenu
```

## sdkconfig.defaults
```kconfig
CONFIG_ESP32C3=y
CONFIG_ESP32_DEFAULT_CPU_FREQ_MHZ=160
CONFIG_ESP_WIFI_SOFTAP_SAE_SUPPORT=y
CONFIG_ESP_WIFI_SOFTAP_PASSWORD=12345678
CONFIG_ESP_WIFI_SOFTAP_SSID=ESP32-SoftAP
CONFIG_ESP_WIFI_SOFTAP_CHANNEL=1
CONFIG_ESP_MQTT_BROKER_URI=mqtt://test.mosquitto.org
CONFIG_ESP_MQTT_PORT=1883
CONFIG_MQTT_PROTOCOL_311=y
CONFIG_HTTPD_MAX_REQ_HDR_LEN=1024
CONFIG_HTTPD_MAX_URI_LEN=512
CONFIG_ESPTOOLPY_FLASHSIZE_4MB=y
CONFIG_ESPTOOLPY_FLASHSIZE=4MB
CONFIG_PARTITION_TABLE_CUSTOM=y
CONFIG_PARTITION_TABLE_CUSTOM_FILENAME="custom_partitions.csv"
```
